## layers/fuel-meter/conf/layer.conf
```bitbake
# We have a conf and classes directory, add to BBPATH
BBPATH .= ":${LAYERDIR}"

# We have recipes-* directories, add to BBFILES
BBFILES += "${LAYERDIR}/recipes-*/*/*.bb \
            ${LAYERDIR}/recipes-*/*/*.bbappend"

BBFILE_COLLECTIONS += "fuel-meter"
BBFILE_PATTERN_fuel-meter = "^${LAYERDIR}/"
BBFILE_PRIORITY_fuel-meter = "6"

LAYERDEPENDS_fuel-meter = "core"
LAYERSERIES_COMPAT_fuel-meter = "scarthgap"
```
